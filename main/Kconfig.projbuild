## main/Kconfig.projbuild
```kconfig
menu "Camera Remote"
    config REMOTE_XIAO_ESP32C6
        bool "Initialize XIAO ESP32C6 onboard antenna"
        depends on IDF_TARGET_ESP32C6
        default y
        help
            Reserve GPIO3 and GPIO14 for the XIAO RF switch and drive both low
            before starting Bluetooth to select the onboard antenna.
            Disable this option when using other development boards.
    config REMOTE_BUTTON_GPIO
        int "Active-low shutter button GPIO"
        range 0 30
        default 9
    config REMOTE_LED_ENABLED
        bool "Enable onboard addressable RGB LED"
        default n
        help
            XIAO ESP32C6 has a single-color user LED, not an addressable RGB LED.
            Leave disabled for XIAO; inspect controller state through USB logs.
    config REMOTE_LED_GPIO
        int "RGB LED GPIO"
        depends on REMOTE_LED_ENABLED
        range 0 30
        default 8
endmenu
```

## sdkconfig.defaults
```kconfig
CONFIG_IDF_TARGET="esp32c6"
CONFIG_BT_ENABLED=y
CONFIG_BT_BLUEDROID_ENABLED=y
CONFIG_BT_BLE_42_FEATURES_SUPPORTED=y
CONFIG_BT_BLE_50_FEATURES_SUPPORTED=n
CONFIG_ESPTOOLPY_FLASHSIZE_4MB=y
CONFIG_REMOTE_XIAO_ESP32C6=y
CONFIG_REMOTE_BUTTON_GPIO=9
# CONFIG_REMOTE_LED_ENABLED is not set
CONFIG_ESP_CONSOLE_USB_SERIAL_JTAG=y
CONFIG_ESP_CONSOLE_SECONDARY_NONE=y
CONFIG_ESP_MAIN_TASK_STACK_SIZE=8192
CONFIG_COMPILER_OPTIMIZATION_SIZE=y
```
